## test/sdkconfig.defaults
```kconfig
# ESP-IDF SDK Configuration for Unit Testing
# This configuration is optimized for running unit tests with Unity framework

# Compiler optimizations for testing
CONFIG_COMPILER_OPTIMIZATION_DEBUG=y
CONFIG_COMPILER_OPTIMIZATION_ASSERTIONS_ENABLE=y
CONFIG_COMPILER_STACK_CHECK_MODE_STRONG=y

# Debugging support
CONFIG_ESP_SYSTEM_PANIC_PRINT_HALT=y
CONFIG_ESP_DEBUG_OCDAWARE=y

# Memory debugging
CONFIG_HEAP_POISONING_COMPREHENSIVE=y
CONFIG_HEAP_TRACING=y
CONFIG_HEAP_TASK_TRACKING=y

# FreeRTOS configuration for testing
CONFIG_FREERTOS_HZ=1000
CONFIG_FREERTOS_WATCHPOINT_END_OF_STACK=y
CONFIG_FREERTOS_THREAD_LOCAL_STORAGE_POINTERS=3
CONFIG_ESP_MAIN_TASK_STACK_SIZE=16384

# Log configuration
CONFIG_LOG_DEFAULT_LEVEL_DEBUG=y
CONFIG_LOG_MAXIMUM_LEVEL_VERBOSE=y
CONFIG_LOG_COLORS=y

# ESP Timer
CONFIG_ESP_TIMER_TASK_STACK_SIZE=4096
CONFIG_ESP_TIMER_INTERRUPT_LEVEL=1

# Unit testing specific
CONFIG_UNITY_ENABLE_DOUBLE=y
CONFIG_UNITY_ENABLE_64BIT=y
CONFIG_UNITY_ENABLE_COLOR=y

# GPIO Configuration
CONFIG_GPIO_ESP32_SUPPORT_SWITCH_SLP_PULL=y

# ADC Configuration  
CONFIG_ADC_ONESHOT_CTRL_FUNC_IN_IRAM=y
CONFIG_ADC_CONTINUOUS_ISR_IRAM_SAFE=y

# Disable unnecessary components for testing
CONFIG_BT_ENABLED=n
CONFIG_WIFI_ENABLED=n
CONFIG_LWIP_ENABLED=n
CONFIG_ESP_NETIF_ENABLED=n

# Enable hardware abstraction for mocking
CONFIG_HAL_ASSERTIONS_ENABLE=y

# Memory configuration
CONFIG_ESP_SYSTEM_ALLOW_RTC_FAST_MEM_AS_HEAP=y

# Security - disable for testing simplicity
CONFIG_SECURE_BOOT=n
CONFIG_SECURE_FLASH_ENC_ENABLED=n

# Power management - enable for testing
CONFIG_PM_ENABLE=y
CONFIG_PM_DFS_INIT_AUTO=y

# Coverage support (when enabled)
CONFIG_GCOV_ENABLED=y

# Task watchdog configuration for testing
CONFIG_ESP_TASK_WDT=y
CONFIG_ESP_TASK_WDT_PANIC=y
CONFIG_ESP_TASK_WDT_TIMEOUT_S=10
```
